
//       /$$$$$$   /$$$$$$  /$$$$$$$$ /$$$$$$$   /$$$$$$         /$$$$$$   /$$$$$$ 
//      /$$__  $$ /$$__  $$|__  $$__/| $$__  $$ /$$__  $$       /$$__  $$ /$$__  $$
//     | $$  \ $$| $$  \__/   | $$   | $$  \ $$| $$  \ $$      |__/  \ $$|__/  \ $$
//     | $$$$$$$$|  $$$$$$    | $$   | $$$$$$$/| $$$$$$$$ /$$$$$$ /$$$$$/  /$$$$$$/
//     | $$__  $$ \____  $$   | $$   | $$__  $$| $$__  $$|______/|___  $$ /$$____/ 
//     | $$  | $$ /$$  \ $$   | $$   | $$  \ $$| $$  | $$       /$$  \ $$| $$      
//     | $$  | $$|  $$$$$$/   | $$   | $$  | $$| $$  | $$      |  $$$$$$/| $$$$$$$$
//     |__/  |__/ \______/    |__/   |__/  |__/|__/  |__/       \______/ |________/

 ////////////////////////////////////// Connections /////////////////////////////////////

// ************************************************************************************ //
//  NodeMCU <----> oled <----> mpu6050 <---->      servo       <----> servo             //
//                                                                                      //
//    3.3v  <---->  vcc <---->   vcc   <---->    vcc(red)      <---->  vcc(red)         //
//                                                                                      //
//    GND   <---->  GND <---->   GND   <---->    GND(orange)   <---->  GND(orange)      //
//                                                                                      //
//    D2    <---->  SDA <---->   SDA   <---->        ---       <---->     ---           //
//                                                                                      //
//    D1    <---->  SCL <---->   SCL   <---->        ---       <---->     ---           //
//                                                                                      //
//    D5    <---->  --- <---->   ---   <---->  Control(yellow) <---->     ---           //
//                                                                                      //
//    D6    <---->  --- <---->   ---   <---->        ---       <---->  Control(yellow)  //
//                                                                                      //
// ************************************************************************************ //


//********************************************//  starts here //*********************************************************//

//********************************************// librarys //*************************************************************// 
#include <Adafruit_MPU6050.h>
#include <Adafruit_Sensor.h>
#include <Wire.h>
#include <Servo.h>
#include <Adafruit_GFX.h>
#include <Adafruit_SSD1306.h>
//********************************************// librarys //*************************************************************// 


//********************************************// display setup //********************************************************//

//nothing to do here...

#define SCREEN_WIDTH 128 // OLED display width, in pixels
#define SCREEN_HEIGHT 64 // OLED display height, in pixels
#define OLED_RESET -1

#define SCREEN_WIDTH 128 // OLED display width, in pixels
#define SCREEN_HEIGHT 64 // OLED display height, in pixels

#define OLED_RESET     -1
#define SCREEN_ADDRESS 0x3C //if the display doesn't work try  replacing "0x3C" with "0x3D".
Adafruit_SSD1306 display(SCREEN_WIDTH, SCREEN_HEIGHT, &Wire, OLED_RESET);
//********************************************// display setup //********************************************************//

//********************************************// oled display ui images //********************************************************//

static const unsigned char PROGMEM earth[] = {0x00,0x00,0x00,0x00,0x00,0x00,0x00,0x00,0x00,0x00,0x00,0x00,0x00,
0x00,0x00,0x00,0x00,0x00,0x00,0x00,0x04,0x00,0x00,0x00,0x00,0x00,0x7d,0xc0,0x00,0x00,0x00,0x03,0x84,0x38,0x00,0x00,0x00,0x0e,0x00,
0x0e,0x00,0x00,0x00,0x18,0x00,0x03,0x00,0x00,0x00,0x20,0xff,0xe0,0x80,0x00,0x00,0x43,0x88,0x78,0x40,0x00,0x00,0x86,0x18,0x4c,0x20,
0x00,0x01,0x0a,0x60,0x42,0x10,0x00,0x01,0x12,0x43,0xc1,0x10,0x00,0x02,0x22,0x02,0x00,0x88,0x00,0x06,0x6c,0x06,0x00,0xcc,0x00,0x04,
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0x00,0x00,0x00,0x00,0x00,0x00,0x00,0x00,0x00,0x00,0x00};

static const unsigned char PROGMEM rocket[] = {0x00,0x00,0x00,0x00,0x00,0x00,0x00,0x00,0x00,0x00,0x00,0x00,0x00,
0x00,0x00,0x00,0x00,0x00,0x00,0x00,0x00,0x00,0x00,0x00,0x00,0x00,0x00,0x00,0x00,0x00,0x00,0x00,0x00,0x00,0x00,0x00,0x00,0x00,0x00,
0x00,0x00,0x00,0x00,0x00,0x00,0x00,0x00,0x00,0x00,0x00,0x00,0x00,0x00,0x00,0x00,0x00,0x00,0x00,0x00,0x00,0x00,0x00,0x00,0x00,0x00,
0x7e,0x00,0x00,0x00,0x00,0x00,0x00,0x00,0xff,0xf0,0x00,0x00,0x00,0x00,0x00,0x01,0xff,0xfc,0x00,0x00,0x00,0x00,0x00,0x01,0xff,0xff,
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0x00,0x00,0x00,0x00,0x00};

static const unsigned char PROGMEM arrow[] = {0x00,0x00,0x00,0x00,0x00,0x00,0x00,0x00,0x00,0x00,0x00,0x00,0x0e,
0x00,0x00,0x00,0x0e,0x00,0x00,0x00,0x1f,0x00,0x00,0x00,0x1f,0x00,0x00,0x00,0x04,0x00,0x00,0x00,0x00,0x00,0x00,0x00,0x04,0x00,0x00,
0x00,0x04,0x00,0x00,0x00,0x04,0x00,0x00,0x00,0x00,0x00,0x00,0x00,0x04,0x00,0x00,0x00,0x04,0x00,0x00,0x00,0x00,0x00,0x00,0x00,0x04,
0x00,0x00,0x00,0x04,0x00,0x30,0x00,0x0e,0x00,0x3c,0x00,0x0b,0xff,0xfc,0x00,0x0e,0x00,0x3c,0x00,0x00,0x00,0x30,0x00,0x00,0x00,0x00,
0x00,0x00,0x00,0x00,0x00,0x00,0x00,0x00,0x00};


//********************************************// oled display ui images //********************************************************//

//********************************************// setup and variables //********************************************************//
//some servo stuff here 
Servo servoX;
Servo servoY;
int servoXpin = 12;
int servoYpin = 14;
//nothing to do here too...
int pos = 0;
int16_t ax, ay, az ;
Adafruit_MPU6050 mpu;
//********************************************// setup and variables //********************************************************//

//********************************************// configurations //********************************************************//

void setup(void) {
  Serial.begin(115200);
  display.begin(SSD1306_SWITCHCAPVCC, SCREEN_ADDRESS);
  display.clearDisplay(); //for Clearing the display
  display.display();
  while (!Serial) {
    delay(10);
  }
  // Try to initialize mpu6050!
  if (!mpu.begin()) {
    Serial.println("Failed to find MPU6050 chip");
    while (1) {
      delay(10);
    }
  }
  mpu.setAccelerometerRange(MPU6050_RANGE_16_G);
  mpu.setGyroRange(MPU6050_RANGE_250_DEG);
  mpu.setFilterBandwidth(MPU6050_BAND_21_HZ);
  Serial.println("");
  delay(100);
  servoX.attach(servoXpin, 1000, 2000);
  servoY.attach(servoYpin, 1000, 2000);

}

//********************************************// configurations //********************************************************//


//********************************************// main loop here //********************************************************//
void loop() {
  /* Get new sensor events with the readings */
  sensors_event_t a, g, temp;
  mpu.getEvent(&a, &g, &temp);
  // to print x, y & z values
  Serial.print(g.gyro.x);
  Serial.print("\t");
  Serial.print(g.gyro.y);
  Serial.print("\t");
  Serial.print(g.gyro.z);
  Serial.println("");
  // It's here where the magic happens...... This is mapping function. It takes output from mpu6050 and maps to servo motor.
  ax = map (a.acceleration.x, -10, 10, 0, 180) ;
  ay = map (a.acceleration.y, -10, 10, 0, 180) ;
 
  servoX.write(ax);    // tell servo to go to position in variable 'ax'
  //delay(15); 
  delay(10);
  servoY.write(ay);    // tell servo to go to position in variable 'ay'
  //delay(15); 
  delay(10);


display.clearDisplay();

display.drawBitmap(86, 21, earth, 42, 43, 1);

display.drawBitmap(25, 0, rocket, 64, 64, 1);

display.setTextColor(1);
display.setTextWrap(false);

display.drawRect(87, 22, 41, 42, 1);

display.setTextColor(1);
display.setCursor(87, 3);
display.print("X:");

display.setCursor(100, 12);
display.print(g.gyro.y);

display.setCursor(87, 12);
display.print("Y:");

display.setCursor(100, 3);
display.print(g.gyro.x);

display.drawBitmap(0 , 39, arrow , 25, 25, 1);

display.setTextColor(1);
display.setCursor(22, 55);
display.print(g.gyro.x);

display.setCursor(1, 33);
display.print(g.gyro.y);

display.display();
}
//********************************************// finally... the end of the code //********************************************************//

